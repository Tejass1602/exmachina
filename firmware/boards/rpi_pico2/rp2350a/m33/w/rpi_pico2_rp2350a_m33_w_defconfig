## firmware/boards/rpi_pico2/rp2350a/m33/w/rpi_pico2_rp2350a_m33_w_defconfig
```kconfig
# RP2350A Cortex-M33 with wireless (Pico 2 W)
CONFIG_SOC_SERIES_RP2XXX=y
CONFIG_SOC_RP2350A=y
CONFIG_CPU_CORTEX_M33=y

# Memory
CONFIG_SRAM_SIZE=520
CONFIG_SRAM_BASE_ADDRESS=0x20000000
CONFIG_FLASH_SIZE=4096
CONFIG_FLASH_BASE_ADDRESS=0x10000000

# Clock
CONFIG_SYS_CLOCK_HW_CYCLES_PER_SEC=150000000

# Console
CONFIG_CONSOLE=y
CONFIG_UART_CONSOLE=y
CONFIG_UART_CONSOLE_ON_DEV_NAME="UART_0"

# Pinmux
CONFIG_PINMUX=y
CONFIG_PINMUX_RP2040=y

# GPIO
CONFIG_GPIO_RP2040=y

# USB
CONFIG_USB_DC_RP2040=y
```
